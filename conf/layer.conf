## conf/layer.conf
```bitbake
# We have a conf and classes directory, add to BBPATH
BBPATH .= ":${LAYERDIR}"

# We have recipes-* directories, add to BBFILES
BBFILES += "${LAYERDIR}/recipes-*/*/*.bb \
            ${LAYERDIR}/recipes-*/*/*.bbappend"

BBFILE_COLLECTIONS += "meta-custom-led"
BBFILE_PATTERN_meta-custom-led = "^${LAYERDIR}/"
BBFILE_PRIORITY_meta-custom-led = "6"

LAYERDEPENDS_meta-custom-led = "core"
LAYERSERIES_COMPAT_meta-custom-led = "scarthgap mickledore"
```
